## CMakeLists.txt
```
cmake_minimum_required(VERSION 3.20.0)
find_package(Zephyr REQUIRED HINTS $ENV{ZEPHYR_BASE})
project(sp1-phase0)

target_sources(app PRIVATE
  src/main.c
  src/leds.c
  src/saadc.c
  src/pwm.c
  src/emmc.c
  src/disk.c
  src/usb.c
  src/codec.c
  src/audio.c
)
```

## prj.conf
```kconfig
CONFIG_PM=n
CONFIG_PM_DEVICE=n
CONFIG_LOG=n
CONFIG_PRINTK=n
CONFIG_ASSERT=n
CONFIG_CONSOLE=n
CONFIG_UART_CONSOLE=n
CONFIG_USE_SEGGER_RTT=n
CONFIG_MAIN_STACK_SIZE=4096
CONFIG_IDLE_STACK_SIZE=256
CONFIG_ISR_STACK_SIZE=2048
CONFIG_SYSTEM_WORKQUEUE_STACK_SIZE=2048
CONFIG_USBD_THREAD_STACK_SIZE=2048
# Catch stack overflows as a fault instead of silent corruption
CONFIG_HW_STACK_PROTECTION=y
CONFIG_CLOCK_CONTROL=y
CONFIG_CLOCK_CONTROL_NRF_K32SRC_SYNTH=y
CONFIG_I2C=y
CONFIG_I2S=y
# Deep TX queue so bursty eMMC refills don't underrun (matches NUM_BLOCKS)
CONFIG_I2S_NRFX_TX_BLOCK_COUNT=48
# TAS2505 reset is on P0.09 (NFC1) — reclaimed as GPIO via &uicr in sp1.dts

# USB CDC ACM for stem upload protocol
CONFIG_RING_BUFFER=y
CONFIG_RING_BUFFER_LARGE=y
CONFIG_SERIAL=y
CONFIG_USB_DEVICE_STACK_NEXT=y
# More UDC buffers → more bulk-OUT transfers in flight → higher upload throughput
CONFIG_UDC_BUF_COUNT=32
CONFIG_UDC_BUF_POOL_SIZE=24576
CONFIG_USBD_CDC_ACM_CLASS=y
CONFIG_UART_LINE_CTRL=y
CONFIG_CDC_ACM_SERIAL_INITIALIZE_AT_BOOT=y
CONFIG_CDC_ACM_SERIAL_PRODUCT_STRING="SP-1 Stem Player"
CONFIG_CDC_ACM_SERIAL_MANUFACTURER_STRING="marisko"
CONFIG_CDC_ACM_SERIAL_VID=0x2FE3
CONFIG_CDC_ACM_SERIAL_PID=0x0101
CONFIG_CDC_ACM_SERIAL_MAX_POWER=100
```

## boards/sp1_nrf52840.overlay
```dts
/*
 * DTS overlay for SP-1 app: enables USB device controller + CDC ACM UART.
 * CDC_ACM_SERIAL_INITIALIZE_AT_BOOT uses DT_CHOSEN(zephyr_console) to locate
 * the CDC ACM instance to register; we point it here without enabling the
 * Zephyr console subsystem (CONFIG_CONSOLE=n), so it is used only for our
 * stem upload protocol.
 */

/ {
	chosen {
		zephyr,console = &stem_uart;
	};
};

zephyr_udc0: &usbd {
	compatible = "nordic,nrf-usbd";
	status = "okay";

	stem_uart: stem_uart {
		compatible = "zephyr,cdc-acm-uart";
		/* Large RX FIFO so the class can enqueue big multi-packet bulk-OUT
		 * transfers (see usbd_cdc_acm.c patch) → upload throughput. */
		rx-fifo-size = <8192>;
		tx-fifo-size = <2048>;
	};
};
```

## src/main.c
```c
#include <zephyr/kernel.h>
#include <soc.h>

#include "util.h"
#include "leds.h"
#include "saadc.h"
#include "pwm.h"
#include "emmc.h"
#include "usb.h"
#include "codec.h"
#include "audio.h"
#include "disk.h"

/* On any fatal error (incl. stack-overflow fault with HW_STACK_PROTECTION):
 * light all 8 LEDs solid and feed the WDT forever, so a crash is visible. */
void k_sys_fatal_error_handler(unsigned int reason, const struct arch_esf *esf)
{
	(void)reason; (void)esf;
	for (int i = 0; i < NUM_PB_LEDS; i++) set_pb_on(i);
	for (int i = 0; i < 4; i++) set_trk_on(i);
	for (;;) feed_wdt();
}

/* ── Power ─────────────────────────────────────────────────────────────────── */

static void enter_system_off(void)
{
	all_pb_off();
	NRF_PWM0->TASKS_STOP = 1;
	feed_wdt();
	NRF_POWER->RESETREAS = 0xFFFFFFFF;
	NRF_POWER->SYSTEMOFF  = 1;
	__DSB();
	for (;;);
}

/* Headphone level via CS42L42 mixer volume (MIXER_CHA/CHB_VOL). 0x00 = 0 dB
 * (full scale — too loud for headphones); attenuation grows with the code.
 * Level 0 = silence (handled by muting HP_CTL, since the mixer can't fully
 * mute); levels 1..7 cap well below full scale. Tune by ear. */
static const uint8_t vol_hp[8] = {0x00, 0x1D, 0x1A, 0x17, 0x14, 0x11, 0x0D, 0x0A};

/* Apply a 0..7 volume level to the headphone output: level 0 mutes via HP_CTL,
 * higher levels unmute and set the mixer attenuation. */
static void hp_apply_level(int lvl)
{
	if (lvl <= 0) {
		codec_headphone_mute(true);
	} else {
		codec_headphone_volume(vol_hp[lvl]);
		codec_headphone_mute(false);
	}
}

/* Decode the AIN0 track-button ladder into a bitmask of held stems (bit s = stem
 * s). Measured on-device: singles + all pairs are distinct, gaps ≥80 counts, so
 * a ±50 nearest-match is unambiguous. Triples/quad are unmeasured → return 0
 * (no solo) rather than a wrong guess. Returns 0 for idle / Play / unknown. */
static uint8_t track_mask(int al)
{
	static const struct { int16_t v; uint8_t m; } tbl[] = {
		{ 207, 0x1 }, { 401, 0x2 }, { 576, 0x3 }, { 725, 0x4 }, { 860, 0x5 },
		{ 981, 0x6 }, { 1211, 0x8 }, { 1307, 0x9 }, { 1390, 0xA }, { 1547, 0xC },
	};
	if (al < 120) return 0;
	for (unsigned i = 0; i < sizeof(tbl) / sizeof(tbl[0]); i++) {
		int d = al - tbl[i].v;
		if (d < 0) d = -d;
		if (d <= 50) return tbl[i].m;
	}
	return 0;
}

/* ── Stem faders ─────────────────────────────────────────────────────────────
 * The faders drive per-stem mix gain and must respond in real time. The audio
 * feed thread is cooperative and spends ~40% of wall-clock in long bit-bang
 * eMMC reads, during which the (lower-priority) main thread can't run — so
 * sampling the faders in main makes them freeze in ~68 ms chunks. Instead a
 * small thread, priority ABOVE the feed thread, samples the faders at ~125 Hz;
 * it preempts the feed even mid-read (a ~150 µs blip the deep TX queue absorbs)
 * so gain tracks the faders with no audible lag. */
#define FADER_MIN 120   /* raw ADC at bottom of travel → gain 0 */
#define FADER_MAX 3100  /* raw ADC at top of travel    → gain 256 (unity) */
#define VU_REF    171   /* baked level 0..255 that fills the 4-bar pb meter */

/* Shared UI state: the buttons (main thread) write these, the UI thread reads
 * them to render the pb-LED meter. */
static volatile int s_vol_level   = 3;   /* current 0..7 volume level */
static volatile int s_meter_ticks = 0;   /* >0 = show the volume bar (UI counts down) */

/* Stem on/off (track-button tap) + momentary solo (track-button hold), folded
 * into the fader gains by the UI thread. s_solo_mask: 0 = no solo, else a bit
 * per stem that is currently soloed (only those play). Multiple stems can be
 * muted at once (independent taps). */
static volatile uint8_t s_stem_muted[4] = {0, 0, 0, 0};
static volatile uint8_t s_solo_mask = 0;

K_THREAD_STACK_DEFINE(s_ui_stack, 1024);
static struct k_thread s_ui_thread;

/* UI thread: samples the 4 faders and renders both LED visualizers at ~125 Hz.
 * Runs ABOVE the audio feed thread so it preempts the feed's long eMMC reads —
 * the faders and the meters stay real-time instead of freezing in ~68 ms chunks
 * (which is what happened when this ran in the read-starved main thread). Its
 * per-tick work is ~0.2 ms, a blip the deep TX queue absorbs. */
static void ui_main(void *a, void *b, void *c)
{
	(void)a; (void)b; (void)c;
	/* saadc pselp per fader (= AIN+1): F1=AIN3=4 (stem0), F2=AIN6=7 (stem1),
	 * F3=AIN2=3 (stem2), F4=AIN7=8 (stem3). */
	static const uint8_t fader_ch[4] = {4u, 7u, 3u, 8u};
	int vu_disp = 0;
	int trk_disp[4] = {0, 0, 0, 0};
	/* Smooth real-time playback position for the meters. The feed thread's
	 * s_cur_block freezes for ~68 ms during each eMMC read then jumps, which
	 * makes the meters stutter. ui_blk advances at the audio rate (375 blk/s →
	 * 3 blocks per 8 ms tick) and is gently eased toward the real position to
	 * stay aligned and to follow song changes / seeks. */
	int32_t ui_blk = 0;

	uint16_t gains[4] = {256, 256, 256, 256};
	int fi = 0;
	/* Track-button state (sensed here at 125 Hz so quick taps aren't dropped).
	 * Tap = toggle the held stem(s); hold >250 ms = solo them until release.
	 * Both work with multiple buttons at once (see track_mask). */
	bool    trk_held    = false;  /* any track button down */
	bool    trk_soloed  = false;  /* this hold has activated solo */
	uint8_t trk_last    = 0;      /* last non-zero held mask (for tap-toggle) */
	int64_t trk_press_ms = 0;

	while (1) {
		/* Faders → per-stem mix gain. Sample ONE fader per tick (round-robin):
		 * each fader updates every 4 ticks ≈ 32 ms, still real-time. Hold the
		 * previous gain on a failed read (no stutter). With oversampling bypassed
		 * a read is ~20 µs, cheap enough to do at this high priority. */
		int raw = saadc_read(fader_ch[fi]);
		if (raw >= 0) {
			int t = (raw - FADER_MIN) * 256 / (FADER_MAX - FADER_MIN);
			if (t < 0)   t = 0;
			if (t > 256) t = 256;
			gains[fi] = (uint16_t)t;
		}
		fi = (fi + 1) & 3;

		/* Track buttons on AIN0 → bitmask of held stems. Tap toggles them; a
		 * hold >250 ms solos them, and the solo set follows the held buttons
		 * live (add/remove a finger to change it). */
		uint8_t cur = track_mask(saadc_read(1u));
		if (cur) {
			if (!trk_held) { trk_press_ms = k_uptime_get(); trk_soloed = false; trk_held = true; }
			trk_last = cur;
			if (!trk_soloed && k_uptime_get() - trk_press_ms > 250) trk_soloed = true;
			if (trk_soloed) s_solo_mask = cur;          /* live solo of the held set */
		} else if (trk_held) {                              /* all released */
			if (trk_soloed) {
				s_solo_mask = 0;
			} else {
				for (int s = 0; s < 4; s++)
					if (trk_last & (1u << s)) s_stem_muted[s] ^= 1u;
			}
			trk_held = false;
		}

		/* Fold in stem on/off + solo: while any stem is soloed, only soloed stems
		 * play; otherwise muted stems are silenced. Fader gain is the base. */
		uint16_t eff[4];
		uint8_t solo = s_solo_mask;
		for (int s = 0; s < 4; s++) {
			if (solo)  eff[s] = (solo & (1u << s)) ? gains[s] : 0;
			else       eff[s] = s_stem_muted[s] ? 0 : gains[s];
		}
		audio_set_stem_gains(eff);

		bool playing = audio_is_playing();

		/* Advance the smooth position at the audio rate, then ease toward the
		 * real (bursty) block to correct drift and follow song changes/seeks. */
		if (playing) ui_blk += 3;
		ui_blk += ((int32_t)audio_cur_block() - ui_blk) >> 4;
		if (ui_blk < 0) ui_blk = 0;
		uint32_t blk = (uint32_t)ui_blk;

		/* pb LEDs: volume bar for ~1 s after a vol button, else the live overall
		 * VU (stems × fader gains), else off. One-pole for a smooth envelope. */
		int fill;
		if (s_meter_ticks > 0) {
			s_meter_ticks--;
			fill = s_vol_level * NUM_PB_LEDS * PWM_TOP / 7;
		} else if (playing) {
			int target = (int)audio_vu_level_at(blk) * (NUM_PB_LEDS * PWM_TOP) / VU_REF;
			if (target > NUM_PB_LEDS * PWM_TOP) target = NUM_PB_LEDS * PWM_TOP;
			vu_disp += (target - vu_disp) / 2;
			fill = vu_disp;
		} else {
			vu_disp = 0;
			fill = 0;
		}
		for (int s = 0; s < NUM_PB_LEDS; s++) {
			int b = fill - s * PWM_TOP;
			if (b < 0)       b = 0;
			if (b > PWM_TOP) b = PWM_TOP;
			pwm1_set_duty(NUM_PB_LEDS - 1 - s, (uint16_t)b);
		}

		/* Track LEDs: per-stem baked level (× fader gain), one-pole smoothed. */
		for (int s = 0; s < 4; s++) {
			int target = playing ? (int)audio_stem_level_at(blk, s) * PWM_TOP / 255 : 0;
			trk_disp[s] += (target - trk_disp[s]) / 2;
			pwm0_set_duty(s, (uint16_t)trk_disp[s]);
		}

		k_msleep(8);
	}
}

/* ── Main ──────────────────────────────────────────────────────────────────── */

int main(void)
{
	/* Drop the main thread BELOW the audio feed thread (preempt 5) so the feed
	 * is never starved by main's button/USB/jack work. Main only needs to run
	 * often enough for input + the watchdog; the feed yields to it whenever its
	 * TX alloc blocks. (Nothing else runs yet, so lowering now is safe.) */
	k_thread_priority_set(k_current_get(), 10);

	NRF_PPI->CHENCLR = 0xFFFFFFFFUL;

	/* P1.10 = PIN_BTN_COM: power rail for button ladders and faders */
	NRF_P1->PIN_CNF[10] = GPIO_OUT_CNF;
	NRF_P1->OUTSET      = (1u << 10);

	/* P0.27 = function button: active-low, pull-up */
	NRF_P0->PIN_CNF[27] =
		(GPIO_PIN_CNF_DIR_Input     << GPIO_PIN_CNF_DIR_Pos)   |
		(GPIO_PIN_CNF_PULL_Pullup   << GPIO_PIN_CNF_PULL_Pos)  |
		(GPIO_PIN_CNF_INPUT_Connect << GPIO_PIN_CNF_INPUT_Pos);

	leds_init();
	saadc_init();
	pwm0_init();
	pwm1_init();   /* pb_leds via PWM1 (dimmable) — before any set_pb_on() */
	usb_cdc_init();

	/* eMMC init: pb_led[0] solid = success.
	 * On failure: pb_led[1] blinks N times = which init step failed (1-9). */
	if (!emmc_init()) {
		uint8_t step = emmc_fail_step();
		for (;;) {
			for (uint8_t i = 0; i < step; i++) {
				set_pb_on(1);
				delay_ms(200);
				all_pb_off();
				delay_ms(200);
			}
			delay_ms(1000);
			feed_wdt();
		}
	}

	feed_wdt();

	/* Audio codec bring-up. Register state available over USB via CODEC_DIAG. */
	bool codec_ok = codec_init();
	feed_wdt();

	/* Scan disk for the first valid song before starting I2S (no concurrent DMA). */
	static disk_header_t s_dh;
	static disk_song_entry_t s_se;
	uint32_t song_block_start = 0, song_block_count = 0;
	uint16_t first_song_idx = 0, total_songs = 0;
	bool song_found = false;
	if (disk_read_header(&s_dh) && s_dh.song_count > 0) {
		total_songs = s_dh.song_count;
		for (uint16_t i = 0; i < s_dh.song_count; i++) {
			if (disk_read_song(i, &s_se) && s_se.name[0] != '\0') {
				song_found       = true;
				first_song_idx   = i;
				song_block_start = s_se.block_start;
				song_block_count = s_se.block_count;
				break;
			}
		}
	}
	feed_wdt();

	/* I2S bring-up + ADPCM playback. Starts paused; play button toggles. */
	if (codec_ok && audio_init()) {
		if (song_found) {
			audio_set_source(AUDIO_SRC_ADPCM);
			audio_set_playlist(total_songs, first_song_idx);
			audio_set_levels_enabled(s_dh.version >= 2);  /* baked VU on v2 discs */
			audio_load_song(song_block_start, song_block_count);
		}
	}
	feed_wdt();

	/* Play button on ladder 1 (AIN0): measured idle≈0, play≈1808, track1≈210.
	 * Detect a press as a window around 1808; toggle play/pause on the edge. */
	int play_prev = 0;

	/* Speaker volume: 8 levels (0 = mute … 7 = loud) → TAS2505 P1/R46 attenuation
	 * (0x00 = 0 dB loudest, larger = quieter). Vol +/- on ladder 2 (AIN1):
	 * measured idle≈0, vol+≈1806, vol-≈729. Boot at a night-friendly level. */
	static const uint8_t vol_r46[8] = {0x7F, 0x48, 0x3C, 0x30, 0x24, 0x18, 0x0C, 0x00};
	int volup_prev = 0;
	int voldn_prev = 0;
	int volup_hold = 0;   /* loops a vol button has been held (for auto-repeat) */
	int voldn_hold = 0;
	int next_prev  = 0;
	int prev_prev  = 0;
	/* vol_level + meter_ticks live at file scope (s_vol_level / s_meter_ticks):
	 * the buttons here write them, the UI thread reads them to render the meter.
	 * The LED visualizers are drawn by the UI thread, not this loop. */

	/* Output routing: speaker (TAS2505) or headphones (CS42L42), chosen by the
	 * CS42L42 jack-sense. Exactly one is unmuted. Debounce jack reads so a noisy
	 * insert doesn't flap. Detect the initial state before the loop so booting
	 * with headphones in starts on the right output. */
	bool hp_out = codec_headphones_present();
	int  hp_raw_prev = hp_out ? 1 : 0;   /* last raw jack read */
	int  hp_debounce = 0;                /* consecutive stable raw reads */
	if (hp_out) {
		codec_speaker_mute(true);
		hp_apply_level(s_vol_level);
	} else {
		codec_speaker_volume(vol_r46[s_vol_level]);
	}

	/* Spawn the UI thread (faders + LED visualizers) at a priority ABOVE the
	 * audio feed thread (K_PRIO_COOP(NUM_COOP-1)) so it preempts the feed's long
	 * eMMC reads and keeps the faders and meters real-time. */
	k_thread_create(&s_ui_thread, s_ui_stack, K_THREAD_STACK_SIZEOF(s_ui_stack),
			ui_main, NULL, NULL, NULL,
			K_PRIO_PREEMPT(1), 0, K_NO_WAIT);
	k_thread_name_set(&s_ui_thread, "ui");

	while (1) {
		if (!(NRF_P0->IN & (1u << 27)))
			enter_system_off();

		bool uploading = usb_upload_active();

		/* Play/pause button (edge-triggered) on ladder 1 (AIN0). */
		int ladder = saadc_read(1u);  /* AIN0 */
		audio_dbg_set_ain0((uint16_t)ladder);   /* expose for threshold tuning via rome audio */
		int play_now = (ladder >= 1650 && ladder <= 1980);
		if (play_now && !play_prev)
			audio_toggle();
		play_prev = play_now;
		/* Track buttons (same AIN0 ladder) are sensed in the UI thread so quick
		 * taps aren't dropped while main is starved during eMMC reads. */

		/* Ladder 2 (AIN1): prev≈399, vol-≈729, next≈1207, vol+≈1806. */
		int vladder = saadc_read(2u);  /* AIN1 */
		int volup_now = (vladder >= 1620 && vladder <= 1960);
		int next_now  = (vladder >= 1080 && vladder <= 1340);
		int voldn_now = (vladder >=  620 && vladder <=  860);
		int prev_now  = (vladder >=  300 && vladder <=  520);
		/* Vol +/- with hold-to-repeat: step once on the press edge, then after a
		 * short hold (~180 ms) auto-repeat every ~70 ms while held. */
		enum { VOL_HOLD_DELAY = 10, VOL_HOLD_RATE = 4 };
		int vol_step = 0;
		if (volup_now) {
			if (!volup_prev) { volup_hold = 0; vol_step = 1; }
			else if (++volup_hold >= VOL_HOLD_DELAY && volup_hold % VOL_HOLD_RATE == 0) vol_step = 1;
		} else volup_hold = 0;
		if (voldn_now) {
			if (!voldn_prev) { voldn_hold = 0; vol_step = -1; }
			else if (++voldn_hold >= VOL_HOLD_DELAY && voldn_hold % VOL_HOLD_RATE == 0) vol_step = -1;
		} else voldn_hold = 0;
		if (vol_step > 0 && s_vol_level < 7) s_vol_level++;
		else if (vol_step < 0 && s_vol_level > 0) s_vol_level--;
		else vol_step = 0;
		if (vol_step != 0) {
			if (hp_out) hp_apply_level(s_vol_level);
			else        codec_speaker_volume(vol_r46[s_vol_level]);
			s_meter_ticks = 120;   /* ~1 s of volume bar at the UI thread's 8 ms tick */
		}
		/* Prev/next rocker: skip song + ensure playing. */
		if (next_now && !next_prev) { audio_skip(1);  audio_play(); }
		if (prev_now && !prev_prev) { audio_skip(-1); audio_play(); }
		volup_prev = volup_now;
		voldn_prev = voldn_now;
		next_prev  = next_now;
		prev_prev  = prev_now;

		/* (Faders + both LED visualizers are handled by the UI thread so they
		 * stay real-time during the feed thread's long eMMC reads.) */

		/* Headphone jack sense (every loop ≈ every 18 ms; the I2C read is cheap).
		 * Debounce: 2 stable raw reads before flipping output, so a noisy insert
		 * can't flap but the switch still feels immediate. On a switch, mute the
		 * old output and unmute the new at the current level so loudness stays
		 * roughly consistent across the change. */
		{
			int hp_raw = codec_headphones_present() ? 1 : 0;
			if (hp_raw == hp_raw_prev) {
				if (hp_debounce < 2) hp_debounce++;
			} else {
				hp_debounce = 0;
				hp_raw_prev = hp_raw;
			}
			if (hp_debounce >= 2 && hp_raw != (hp_out ? 1 : 0)) {
				hp_out = hp_raw;
				if (hp_out) {
					codec_speaker_mute(true);
					hp_apply_level(s_vol_level);
				} else {
					codec_headphone_mute(true);
					codec_speaker_volume(vol_r46[s_vol_level]);
					codec_speaker_mute(false);
				}
			}
		}

		/* (The pb + track LED visualizers are rendered by the UI thread.) */
		bool playing = audio_is_playing();

		/* Renode mirror: expose GPIO state for emulator observation */
		*(volatile uint32_t *)0x2000FFF0 = NRF_P0->OUT;
		*(volatile uint32_t *)0x2000FFF4 = NRF_P1->OUT;

		usb_cdc_poll();

		feed_wdt();
		if (!uploading)
			k_msleep(playing ? 18 : 30);   /* faster while playing → smoother VU */

		if (!(NRF_P0->IN & (1u << 27)))
			enter_system_off();
	}

	return 0;
}
```

## src/audio.c
```c
#include "audio.h"
#include "codec.h"
#include "emmc.h"
#include "disk.h"
#include "leds.h"
#include "pwm.h"
#include "util.h"

#include <zephyr/device.h>
#include <zephyr/drivers/i2s.h>

/* 24-bit SWIDTH, stereo, 48 kHz. DMA word = {sample[23:0], 8'h00} per channel. */
#define FRAMES_PER_BLOCK 128u
#define CHANNELS         2u
#define BYTES_PER_WORD   4u
#define BLOCK_BYTES      (FRAMES_PER_BLOCK * CHANNELS * BYTES_PER_WORD)
#define NUM_BLOCKS       48u   /* ~128 ms TX runway: absorbs a 23 ms read burst + heavy
                              * main-thread preemption without underrunning the I2S DMA */
#define I2S_TIMEOUT_MS   200u

K_MEM_SLAB_DEFINE_STATIC(s_tx_slab, BLOCK_BYTES, NUM_BLOCKS, 4);

#define FEED_STACK 2048
K_THREAD_STACK_DEFINE(s_feed_stack, FEED_STACK);
static struct k_thread s_feed_thread;

static const struct device *s_i2s;
static volatile audio_source_t s_source = AUDIO_SRC_SILENCE;
static volatile bool s_running;

/* ── 440 Hz sine via a 2nd-order resonator (no libm) ─────────────────────── */
#define TONE_A   4.0e7f   /* y1_init ≈ 2.3e6, within 24-bit ±8.4e6 range */
#define TONE_K   1.9966822f
#define TONE_SW  0.0575539f
static float s_y1, s_y2;

static void tone_reset(void)
{
	s_y2 = 0.0f;
	s_y1 = TONE_A * TONE_SW;
}

/* ── IMA-ADPCM decoder ─────────────────────────────────────────────────────
 * Channels 0 (L) and 1 (R) of stem 0. State carries across blocks.
 * Disk layout: ch0 = bytes [0..63], ch1 = bytes [64..127], low nibble first.
 */
static const int16_t s_step_table[89] = {
	7, 8, 9, 10, 11, 12, 13, 14, 16, 17, 19, 21, 23, 25, 28,
	31, 34, 37, 41, 45, 50, 55, 60, 66, 73, 80, 88, 97, 107, 118,
	130, 143, 157, 173, 190, 209, 230, 253, 279, 307, 337, 371, 408,
	449, 494, 544, 598, 658, 724, 796, 876, 963, 1060, 1166, 1282,
	1411, 1552, 1707, 1878, 2066, 2272, 2499, 2749, 3024, 3327, 3660,
	4026, 4428, 4871, 5358, 5894, 6484, 7132, 7845, 8630, 9493, 10442,
	11487, 12635, 13899, 15289, 16818, 18500, 20350, 22385, 24623,
	27086, 29794, 32767
};
static const int8_t s_index_table[16] = {
	-1, -1, -1, -1, 2, 4, 6, 8, -1, -1, -1, -1, 2, 4, 6, 8
};

static int16_t  s_pred[8];
static int8_t   s_sidx[8];
static uint32_t s_song_block_start;
static uint32_t s_song_block_count;
static uint32_t s_cur_block;
static volatile bool s_playing;

/* Playlist: feed thread advances to the next catalog song at end-of-song,
 * wrapping after the last. disk_read_song runs in the feed thread (same thread
 * that owns the eMMC during playback) — no cross-thread bus race. */
static uint16_t s_song_count;     /* total catalog entries */
static uint16_t s_cur_song;       /* current catalog index */
static volatile int s_skip_req;   /* +1 = next, -1 = prev (rocker); 0 = none */

static void lvl_setup(uint32_t block_start, uint32_t block_count);

/* Move to the next valid catalog song in direction dir (+1 next, -1 prev),
 * wrapping. Runs in the feed thread (disk_read_song = eMMC). */
static void change_song(int dir)
{
	if (s_song_count == 0) return;
	disk_song_entry_t e;
	int n = (int)s_song_count;
	for (int step = 1; step <= n; step++) {
		int idx = ((int)s_cur_song + dir * step) % n;
		if (idx < 0) idx += n;
		if (disk_read_song((uint16_t)idx, &e) && e.name[0] != '\0') {
			s_cur_song          = (uint16_t)idx;
			s_song_block_start  = e.block_start;
			s_song_block_count  = e.block_count;
			lvl_setup(e.block_start, e.block_count);
			return;
		}
	}
	/* No other valid song — current one just loops (start/count unchanged). */
}

/* Prefetch: one slow bit-bang CMD17 per 128-frame buffer (~2-3 ms) can't keep
 * up with the 2.67 ms playback budget → underrun buzz. Read PREFETCH_BLOCKS at
 * once via CMD18 streaming (amortizes command overhead) and decode from RAM. */
#define PREFETCH_BLOCKS 64u  /* amortizes the ~7 ms fixed per-read CMD overhead. The
                              * cost is data(~1.01 ms/blk) + 7 ms/N: N=16→1.45, N=32→
                              * 1.23 ms/blk. The decode+write of a 4-stem block eats the
                              * rest of the 2.67 ms budget, so cutting read/blk is the
                              * only steady-state margin left. Bigger N is monotonically
                              * better (N=4→2.8 ms blew the budget); deep TX queue absorbs
                              * the longer ~40 ms burst read. */
static uint8_t  s_pf_buf[PREFETCH_BLOCKS * 512u];
static uint32_t s_pf_pos;    /* next block index within s_pf_buf to decode */
static uint32_t s_pf_count;  /* valid blocks currently in s_pf_buf */
static volatile uint32_t s_last_read_us;  /* diag: µs per block of last refill */
static volatile int32_t  s_peak;          /* peak-hold since last read (v1 LED VU fallback) */

/* ── Feed-thread health counters (read via USB AUDIO_DIAG) ─────────────────── */
static volatile uint32_t s_recoveries;    /* TX underrun recoveries (alloc timeout → DROP/START) */
static volatile uint32_t s_write_fails;   /* i2s_write() failures */
static volatile uint32_t s_max_read_us;   /* worst per-block eMMC read time seen (budget 2670) */
static volatile uint32_t s_blocks_fed;    /* total blocks handed to i2s_write */

/* Per-stem mix gain (0..256, 256 = unity), driven live by the 4 faders from the
 * main thread. Default unity so playback is full until faders are read. */
static volatile uint16_t s_stem_gain[4] = {256u, 256u, 256u, 256u};
void audio_set_stem_gains(const uint16_t g[4])
{
	for (int i = 0; i < 4; i++) s_stem_gain[i] = g[i] > 256u ? 256u : g[i];
}

/* ── Baked per-stem VU levels (disk v3) ─────────────────────────────────────
 * rome bakes 4 level bytes per LVL_DECIM audio blocks — one peak per stem
 * (each >> 7, 0..255) — stored interleaved [s0,s1,s2,s3, …]. The whole array is
 * loaded into RAM once at song start (no recurring eMMC during playback). The
 * track LEDs dim to each stem's level; the overall pb-LED meter sums the four
 * scaled by the live fader gains. Index = (cur_block / LVL_DECIM) * 4 + stem;
 * on a feed stall cur_block freezes so the meter holds rather than dropping. */
#define LVL_DECIM     16u       /* audio blocks per baked level sample — must match rome */
#define LVL_STEMS     4u        /* bytes per sample (one peak per stem) */
#define LVL_MAX_BYTES 24576u    /* RAM cap: ~4.4 min @ DECIM=16, 4 stems; longer truncates */

static bool              s_lvl_enabled;   /* disk reports v2 → levels present */
static bool              s_lvl_present;   /* current song has a level region */
static bool              s_lvl_loaded;    /* level array read into RAM for this song */
static uint32_t          s_lvl_start;     /* first level block of current song */
static uint32_t          s_lvl_blocks;    /* level blocks to read (capped) */
static uint32_t          s_lvl_count;     /* valid level bytes in s_lvl_ram */
static uint8_t           s_lvl_ram[LVL_MAX_BYTES];

/* Recompute the level region for a song from its (audio) block_start/count. */
static void lvl_setup(uint32_t block_start, uint32_t block_count)
{
	s_lvl_present = s_lvl_enabled && block_count > 0;
	s_lvl_start   = block_start + block_count;
	uint32_t bytes = ((block_count + LVL_DECIM - 1u) / LVL_DECIM) * LVL_STEMS;
	if (bytes > LVL_MAX_BYTES) bytes = LVL_MAX_BYTES;
	s_lvl_count   = bytes;
	s_lvl_blocks  = (bytes + 511u) / 512u;
	s_lvl_loaded  = false;
}

static int16_t adpcm_step(uint8_t nibble, int ch)
{
	int step = s_step_table[(uint8_t)s_sidx[ch]];
	int diff = step >> 3;
	if (nibble & 4u) diff += step;
	if (nibble & 2u) diff += step >> 1;
	if (nibble & 1u) diff += step >> 2;
	if (nibble & 8u) diff = -diff;
	int pred = s_pred[ch] + diff;
	if (pred >  32767) pred =  32767;
	if (pred < -32768) pred = -32768;
	s_pred[ch] = (int16_t)pred;
	int idx = s_sidx[ch] + s_index_table[nibble & 0xFu];
	if (idx < 0)  idx = 0;
	if (idx > 88) idx = 88;
	s_sidx[ch] = (int8_t)idx;
	return s_pred[ch];
}

/* ── Buffer fill ────────────────────────────────────────────────────────────── */

static void fill_block(int32_t *buf)
{
	if (s_source == AUDIO_SRC_TONE) {
		for (uint32_t i = 0; i < FRAMES_PER_BLOCK; i++) {
			float y = TONE_K * s_y1 - s_y2;
			s_y2 = s_y1;
			s_y1 = y;
			int32_t s = (int32_t)y;
			buf[2 * i]     = s;
			buf[2 * i + 1] = s;
		}
		return;
	}

	if (s_source == AUDIO_SRC_ADPCM && s_playing && s_song_block_count > 0
	    && !emmc_write_multi_active()) {
		if (s_skip_req != 0 || s_cur_block >= s_song_block_count) {
			change_song(s_skip_req < 0 ? -1 : 1);  /* rocker skip, or natural end */
			s_skip_req  = 0;
			s_cur_block = 0;
			s_pf_pos = s_pf_count = 0;   /* force refill from block 0 */
			for (int i = 0; i < 8; i++) { s_pred[i] = 0; s_sidx[i] = 0; }
		}

		/* Refill prefetch buffer when exhausted (batched CMD18 streaming read). */
		if (s_pf_pos >= s_pf_count) {
			uint32_t remaining = s_song_block_count - s_cur_block;
			uint32_t n = remaining < PREFETCH_BLOCKS ? remaining : PREFETCH_BLOCKS;
			uint32_t t0 = k_cycle_get_32();
			bool ok = emmc_read_blocks(s_song_block_start + s_cur_block, s_pf_buf, n);
			uint32_t dt = k_cycle_get_32() - t0;
			/* µs per block = cycles / (cyc_per_us) / n */
			s_last_read_us = k_cyc_to_us_floor32(dt) / (n ? n : 1u);
			if (s_last_read_us > s_max_read_us) s_max_read_us = s_last_read_us;
			if (ok) {
				s_pf_count = n;
				s_pf_pos   = 0;
			} else {
				s_pf_count = s_pf_pos = 0;
				goto tone_fallback;
			}

			/* Load the whole (decimated) level array into RAM once, at the
			 * first refill of the song, while we own the bus. One-time only. */
			if (s_lvl_present && !s_lvl_loaded) {
				if (emmc_read_blocks(s_lvl_start, s_lvl_ram, s_lvl_blocks))
					s_lvl_loaded = true;
			}
		}

		{
			const uint8_t *blk = s_pf_buf + s_pf_pos * 512u;
			int32_t bufpeak = 0;
			s_pf_pos++;
			s_cur_block++;
			for (uint32_t i = 0; i < FRAMES_PER_BLOCK; i++) {
				int32_t l = 0, r = 0;
				/* Mix all 4 stems: each stem = 128 bytes (64 L + 64 R) */
				for (int stem = 0; stem < 4; stem++) {
					uint32_t ol = (uint32_t)stem * 128u + i / 2u;
					uint32_t or_ = (uint32_t)stem * 128u + 64u + i / 2u;
					uint8_t bl = blk[ol];
					uint8_t br = blk[or_];
					uint8_t nl = (i & 1u) ? (bl >> 4) : (bl & 0xFu);
					uint8_t nr = (i & 1u) ? (br >> 4) : (br & 0xFu);
					/* Decode every stem (advances its ADPCM predictor even when
					 * silenced, so a muted fader never desyncs the decoder), then
					 * scale by the live fader gain (0..256, 256 = unity). */
					int32_t g = s_stem_gain[stem];
					l += (adpcm_step(nl, stem * 2)     * g) >> 8;
					r += (adpcm_step(nr, stem * 2 + 1) * g) >> 8;
				}
				/* Average 4 stems (>>2): sum of four ±32767 values is ±131068,
				 * so >>2 → ±32767 max and NEVER clips. The old >>1 clipped hard
				 * whenever 2+ stems were loud → constant crunch/clicks. Make up
				 * the 6 dB with the speaker volume. Clamp kept as a safety net. */
				l >>= 2;
				r >>= 2;
				if (l >  32767) l =  32767;
				if (l < -32768) l = -32768;
				if (r >  32767) r =  32767;
				if (r < -32768) r = -32768;
				/* Track buffer peak for the LED visualizer. */
				int32_t al = l < 0 ? -l : l;
				int32_t ar = r < 0 ? -r : r;
				if (al > bufpeak) bufpeak = al;
				if (ar > bufpeak) bufpeak = ar;
				/* 16-bit sample → 24-bit right-aligned (bits[23:8]) */
				buf[2 * i]     = (int32_t)(l << 8);
				buf[2 * i + 1] = (int32_t)(r << 8);
			}
			/* Peak-hold for the LED VU. Main reads + resets this every loop and
			 * applies its own time-based decay — so the meter stays smooth even
			 * while the feed thread is busy in a multi-block eMMC read. */
			if (bufpeak > s_peak) s_peak = bufpeak;
			return;
		}
tone_fallback:;
		/* eMMC read failed: output tone as audible indicator (vs silence = invisible) */
		for (uint32_t i = 0; i < FRAMES_PER_BLOCK; i++) {
			float y = TONE_K * s_y1 - s_y2;
			s_y2 = s_y1; s_y1 = y;
			int32_t s = (int32_t)y;
			buf[2 * i]     = s;
			buf[2 * i + 1] = s;
		}
		return;
	}

	/* Silence (paused or no song loaded) */
	for (uint32_t i = 0; i < CHANNELS * FRAMES_PER_BLOCK; i++)
		buf[i] = 0;
}

/* ── Feed thread ─────────────────────────────────────────────────────────────── */

static void feed_main(void *a, void *b, void *c)
{
	(void)a; (void)b; (void)c;

	/* Prime a deep queue before START so the first (bursty) eMMC refill has
	 * full TX runway. TX queue holds NUM_BLOCKS; fill all but one. Stop early
	 * and graceful if a write can't be queued. */
	int primed = 0;
	for (int i = 0; i < (int)NUM_BLOCKS - 1; i++) {
		void *blk;
		if (k_mem_slab_alloc(&s_tx_slab, &blk, K_FOREVER) != 0) break;
		fill_block((int32_t *)blk);
		if (i2s_write(s_i2s, blk, BLOCK_BYTES) != 0) {
			k_mem_slab_free(&s_tx_slab, blk);
			break;
		}
		primed++;
	}
	if (primed == 0) return;

	if (i2s_trigger(s_i2s, I2S_DIR_TX, I2S_TRIGGER_START) != 0) return;
	s_running = true;

	while (1) {
		void *blk;

		/* Alloc-timeout = TX underrun (eMMC stall drained the queue) or i2s
		 * error state. Recover and keep going — NEVER exit the thread, or audio
		 * dies for good and play can't restart it. */
		if (k_mem_slab_alloc(&s_tx_slab, &blk, K_MSEC(I2S_TIMEOUT_MS)) != 0) {
			s_recoveries++;
			i2s_trigger(s_i2s, I2S_DIR_TX, I2S_TRIGGER_DROP);
			/* DROP returns all queued buffers to the slab. Re-prime the FULL
			 * queue (not just 2) before restarting — a shallow re-prime drains
			 * before the next ~20 ms eMMC prefetch read completes and underruns
			 * again, cascading. Full runway lets a transient underrun self-heal. */
			for (int i = 0; i < (int)NUM_BLOCKS - 1; i++) {
				if (k_mem_slab_alloc(&s_tx_slab, &blk, K_FOREVER) != 0) break;
				fill_block((int32_t *)blk);
				if (i2s_write(s_i2s, blk, BLOCK_BYTES) != 0) {
					k_mem_slab_free(&s_tx_slab, blk);
					break;
				}
			}
			i2s_trigger(s_i2s, I2S_DIR_TX, I2S_TRIGGER_START);
			continue;
		}

		fill_block((int32_t *)blk);
		if (i2s_write(s_i2s, blk, BLOCK_BYTES) != 0) {
			s_write_fails++;
			k_mem_slab_free(&s_tx_slab, blk);
			/* DMA not running (no BCLK yet or error). Drop into the recovery
			 * path on the next iteration via a short yield. */
			i2s_trigger(s_i2s, I2S_DIR_TX, I2S_TRIGGER_DROP);
			k_sleep(K_MSEC(2));
		} else {
			s_blocks_fed++;
		}
	}
}

/* ── Public API ─────────────────────────────────────────────────────────────── */

bool audio_init(void)
{
	codec_note_audio(0, 1);
	s_i2s = DEVICE_DT_GET(DT_NODELABEL(i2s0));
	if (!device_is_ready(s_i2s)) { codec_note_audio(0, 2); return false; }

	struct i2s_config cfg = {0};
	/* SWIDTH=24 (nRF I2S max; 32 is rejected as EINVAL). Samples are
	 * right-aligned in bits[23:0] of each 32-bit word, MSB(bit23) sent first. */
	cfg.word_size      = 24u;
	cfg.channels       = CHANNELS;
	cfg.format         = I2S_FMT_DATA_FORMAT_I2S;
	cfg.options        = I2S_OPT_BIT_CLK_SLAVE | I2S_OPT_FRAME_CLK_SLAVE;
	cfg.frame_clk_freq = 48000u;
	cfg.mem_slab       = &s_tx_slab;
	cfg.block_size     = BLOCK_BYTES;
	cfg.timeout        = I2S_TIMEOUT_MS;

	int cfg_ret = i2s_configure(s_i2s, I2S_DIR_TX, &cfg);
	codec_note_audio(cfg_ret, 3);
	if (cfg_ret != 0) return false;

	/* Preemptible priority 5 — ABOVE the main thread (lowered to 10) so main's
	 * button/USB/LED work can never starve the feed (that starvation was the old
	 * underrun cause), but BELOW the UI thread (priority 1) so the faders + LED
	 * meters can preempt the feed's long bit-bang eMMC reads and stay real-time.
	 * A cooperative feed could not be preempted at all, which froze the UI for
	 * ~68 ms per read. The feed yields to main whenever its alloc/i2s_write
	 * blocks (TX queue full), which is often, so main still gets WDT/buttons. */
	k_thread_create(&s_feed_thread, s_feed_stack, FEED_STACK,
			feed_main, NULL, NULL, NULL,
			K_PRIO_PREEMPT(5), K_FP_REGS, K_NO_WAIT);
	k_thread_name_set(&s_feed_thread, "i2s_feed");

	k_sleep(K_MSEC(20));
	codec_speaker_volume(0x20);
	codec_speaker_mute(false);

	codec_note_audio_running(s_running);
	codec_note_audio(0, 4);
	return true;
}

void audio_set_source(audio_source_t src)
{
	if (src == AUDIO_SRC_TONE) tone_reset();
	s_source = src;
}

bool audio_running(void)
{
	return s_running;
}

void audio_set_playlist(uint16_t song_count, uint16_t current_idx)
{
	s_song_count = song_count;
	s_cur_song   = current_idx;
}

void audio_load_song(uint32_t block_start, uint32_t block_count)
{
	s_playing          = false;
	s_song_block_start = block_start;
	s_song_block_count = block_count;
	s_cur_block        = 0;
	s_pf_pos = s_pf_count = 0;
	for (int i = 0; i < 8; i++) { s_pred[i] = 0; s_sidx[i] = 0; }
	lvl_setup(block_start, block_count);
}

void audio_set_levels_enabled(bool enabled) { s_lvl_enabled = enabled; }

void audio_play(void)  { s_playing = true; }
void audio_pause(void) { s_playing = false; }
void audio_skip(int dir) { s_skip_req = (dir < 0) ? -1 : 1; }

/* Index of stem `stem` in the baked level array at block `blk`, or UINT32_MAX
 * if there is no valid baked level. The caller passes a smooth real-time block
 * estimate (not s_cur_block, which freezes during eMMC reads → choppy meters). */
static uint32_t lvl_index_at(uint32_t blk, int stem)
{
	if (!s_lvl_present || !s_lvl_loaded || s_lvl_count < LVL_STEMS) return 0xFFFFFFFFu;
	uint32_t idx = (blk / LVL_DECIM) * LVL_STEMS + (uint32_t)stem;
	uint32_t last = s_lvl_count - LVL_STEMS + (uint32_t)stem;
	if (idx > last) idx = last;
	return idx;
}

/* Baked level (0..255) of one stem at block `blk`, scaled by its live fader gain
 * so a muted/faded stem dims. For the per-stem track LEDs. */
uint32_t audio_stem_level_at(uint32_t blk, int stem)
{
	if (stem < 0 || stem > 3) return 0;
	uint32_t idx = lvl_index_at(blk, stem);
	if (idx == 0xFFFFFFFFu) return 0;
	uint32_t v = s_lvl_ram[idx];
	return (v * s_stem_gain[stem]) >> 8;   /* 0..255 */
}

/* Overall VU level (0..255) for the pb-LED meter at block `blk`: the four stems
 * summed, each scaled by its fader gain, so the meter tracks the live mix.
 * Falls back to the on-device peak-hold for discs without baked levels. */
uint32_t audio_vu_level_at(uint32_t blk)
{
	if (s_lvl_present) {
		if (!s_lvl_loaded || s_lvl_count < LVL_STEMS) return 0;
		uint32_t sum = 0;
		for (int s = 0; s < 4; s++) sum += audio_stem_level_at(blk, s);   /* 0..1020 */
		sum >>= 2;                                                        /* 0..255  */
		return sum > 255 ? 255 : sum;
	}
	/* fallback: on-device peak-hold (0..32767), scaled to 0..255. */
	int32_t v = s_peak;
	s_peak = 0;
	v >>= 7;
	return (uint32_t)(v > 255 ? 255 : v);
}

void audio_toggle(void) { s_playing = !s_playing; }

uint32_t audio_cur_block(void) { return s_cur_block; }

uint32_t audio_last_read_us(void) { return s_last_read_us; }

static volatile uint16_t s_dbg_ain0;
void audio_dbg_set_ain0(uint16_t v) { s_dbg_ain0 = v; }

void audio_get_diag(audio_diag_t *d)
{
	if (!d) return;
	d->recoveries  = s_recoveries;
	d->write_fails = s_write_fails;
	d->max_read_us = s_max_read_us;
	d->last_read_us = s_last_read_us;
	d->cur_block   = s_cur_block;
	d->blocks_fed  = s_blocks_fed;
	d->crc_errors  = emmc_crc_errors();
	d->ain0        = s_dbg_ain0;
}

bool audio_is_playing(void) { return s_playing; }
```

## src/audio.h
```c
#pragma once

#include <stdint.h>
#include <stdbool.h>

/*
 * I2S audio output for the SP-1.
 *
 * nRF I2S0 runs as SLAVE: BCLK (3.072 MHz osc) + LRCLK (from CS42L42) are
 * external. 24-bit SWIDTH, stereo, 48 kHz. 32-bit DMA words; sample in [31:8].
 * A dedicated feed thread keeps the TX double-buffer primed.
 *
 * codec_init() must succeed (CS42L42 PLL locked) before audio_init().
 */

typedef enum {
	AUDIO_SRC_SILENCE = 0,
	AUDIO_SRC_TONE,        /* built-in 440 Hz sine — bring-up test */
	AUDIO_SRC_ADPCM,       /* IMA-ADPCM from eMMC (use audio_load_song first) */
} audio_source_t;

/* Configure + start the I2S stream and spawn the feed thread.
 * Unmutes the speaker. Returns false if the I2S device isn't ready. */
bool audio_init(void);

/* Select what the feed thread emits. */
void audio_set_source(audio_source_t src);

/* True once the I2S TX stream has actually started (START trigger succeeded). */
bool audio_running(void);

/* ── ADPCM playback ─────────────────────────────────────────────────────────── */

/* Tell the feed thread the catalog size + current index so it can auto-advance
 * to the next song at end-of-song (wrapping after the last). Call before
 * audio_load_song(). */
void audio_set_playlist(uint16_t song_count, uint16_t current_idx);

/* Enable baked per-block VU levels (disk v2). The level array (one decimated
 * byte per LVL_DECIM audio blocks) follows each song's audio at
 * block_start + block_count; the feed thread loads it into RAM once at song
 * start. Disable for v1 discs → falls back to on-device peak. Call before
 * audio_load_song(). */
void audio_set_levels_enabled(bool enabled);

/* Set the song to play (block_start + block_count from the disk catalog).
 * Resets ADPCM state to silence; call audio_play() to start. */
void audio_load_song(uint32_t block_start, uint32_t block_count);

/* Live per-stem mix gain from the 4 faders (0..256, 256 = unity, 0 = silent).
 * Index = stem (0..3). The feed thread applies these in the mix; muted stems
 * still advance their ADPCM decoder so they never desync. Safe from main. */
void audio_set_stem_gains(const uint16_t g[4]);

/* Play / pause / toggle. Safe to call from the main thread at any time. */
void audio_play(void);
void audio_pause(void);
void audio_toggle(void);
bool audio_is_playing(void);

/* Skip to next (dir>0) or previous (dir<0) song. Processed by the feed thread;
 * the song change reads the catalog (eMMC) there to avoid a bus race. */
void audio_skip(int dir);

/* Overall VU level (0..255) for the pb-LED meter at block `blk` — the four
 * baked stem levels summed and scaled by the live fader gains (disk v3). Falls
 * back to on-device peak-hold on discs without baked levels. The caller passes
 * a smooth real-time block estimate (not audio_cur_block(), which freezes during
 * eMMC reads → choppy meters) and applies light smoothing. */
uint32_t audio_vu_level_at(uint32_t blk);

/* Baked per-stem VU level (0..255) at block `blk`, scaled by the stem's live
 * fader gain (disk v3). Index = stem 0..3. For the track LEDs. 0 if no levels. */
uint32_t audio_stem_level_at(uint32_t blk, int stem);

/* Diagnostic: current playback position (relative block index into the song). */
uint32_t audio_cur_block(void);

/* Diagnostic: µs per block of the last eMMC refill read (budget is 2670 µs). */
uint32_t audio_last_read_us(void);

/* Feed-thread health snapshot (USB AUDIO_DIAG). recoveries/write_fails > 0 means
 * the I2S TX queue underran; max_read_us > 2670 means an eMMC read missed the
 * realtime budget. blocks_fed should climb steadily during playback. */
typedef struct {
	uint32_t recoveries;
	uint32_t write_fails;
	uint32_t max_read_us;
	uint32_t last_read_us;
	uint32_t cur_block;
	uint32_t blocks_fed;
	uint32_t crc_errors;   /* corrupt eMMC reads caught by CRC16 (mirror of emmc_crc_errors) */
	uint32_t ain0;         /* last raw AIN0 (track+play button ladder) — for tuning thresholds */
} audio_diag_t;
void audio_get_diag(audio_diag_t *d);

/* Publish the latest raw AIN0 ladder reading for the diag (called from main). */
void audio_dbg_set_ain0(uint16_t v);
```

## src/codec.h
```c
#pragma once

#include <stdint.h>
#include <stdbool.h>

/*
 * Audio codec bring-up for the SP-1.
 *
 * Two codecs on I2C0 (SDA P1.07, SCL P1.11):
 *   CS42L42 @ 0x48 — headphone codec; also generates the I2S LRCLK (frame clock)
 *                     so it MUST be initialized for any audio to clock at all.
 *   TAS2505 @ 0x18 — mono speaker class-D amp (our output target).
 *
 * Clock chain: external 3.072 MHz oscillator enabled by P0.13 high provides
 * BCLK. CS42L42 PLLs off it and produces the 48 kHz LRCLK. The nRF I2S runs
 * as SLAVE off BCLK + LRCLK.
 *
 * Reset lines (active-low): CS42L42 = P0.15, TAS2505 = P0.09 (NFC1 reclaimed).
 */

/* Bring up the oscillator + both codecs (register scripts ported from the
 * sp1-midi drivers). Leaves both outputs MUTED. Returns true if every I2C
 * transaction succeeded. */
bool codec_init(void);

/* Speaker (TAS2505) mute control. */
bool codec_speaker_mute(bool mute);

/* Speaker volume: 0x00 = max gain, 0x7F = mute (TAS2505 P1/R46 scale). */
bool codec_speaker_volume(uint8_t vol);

/* Headphone (CS42L42) mute control. HP_CTL 0x2001: 0x0E=mute, 0x02=unmute
 * (values from the sp1-midi cs42l42 driver). The codec inits muted. */
bool codec_headphone_mute(bool mute);

/* Headphone volume: writes HP_VOL_A (0x2601) + HP_VOL_B (0x2609). The stock
 * bring-up listening level is 0x4C; larger raw = more attenuation (quieter).
 * Exact dB/step is uncalibrated — tune the table in main.c by ear. */
bool codec_headphone_volume(uint8_t vol);

/* True if headphones are plugged into the TRRS jack. Reads CS42L42
 * TSRS_PLUG_STATUS (0x130F): plugged when ((reg & 0x0C) >> 2) == 0x03
 * (logic from the sp1-midi cs42l42_codec_is_headphone_connected). Tip-sense
 * detection is enabled during codec_init (MIC_DET_CTL1 + TIPSENSE_CTL). */
bool codec_headphones_present(void);

/* Diagnostic snapshot for the USB CODEC_DIAG command. 32 bytes. */
typedef struct {
	uint8_t  init_ok;        /* 1 if codec_init() returned true */
	uint8_t  cs_devid_ab;    /* expect 0x42 */
	uint8_t  cs_devid_cd;    /* expect 0xA4 */
	uint8_t  cs_devid_e;
	uint8_t  cs_pll_lock;    /* CS42L42 0x130E PLL lock status */
	uint8_t  cs_clock_ctl;   /* 0x1007 */
	uint8_t  cs_pwr_ctl1;    /* 0x1101 */
	uint8_t  cs_hp_ctl;      /* 0x2001 */
	uint8_t  tas_p0r2;       /* TAS2505 P0/R2 (overflow/PLL flags vary) */
	uint8_t  tas_p1r46;      /* speaker driver volume */
	uint8_t  tas_p1r45;      /* speaker amp control */
	uint8_t  tas_p0r63;      /* DAC channel setup */
	uint8_t  i2c_errors;     /* count of failed I2C transactions during init */
	uint8_t  audio_running;  /* set by usb layer: I2S TX stream started */
	/* live re-reads (current state, captured when CODEC_DIAG is requested) */
	uint8_t  live_cs_pll;    /* CS42L42 PLL lock now */
	uint8_t  live_tas_p1r46; /* speaker volume now (0x00=max, 0x7F=mute) */
	uint8_t  live_tas_p1r45; /* speaker amp ctl now (0x02=on) */
	uint8_t  live_tas_p0r63; /* DAC path now (0xB0=on) */
	uint8_t  live_tas_p0r64; /* DAC vol now */
	uint8_t  live_tas_p0r65; /* DAC L vol now */
	uint8_t  live_tas_p0r25; /* clock mux status */
	int8_t   audio_i2s_cfg_ret; /* i2s_configure() return code */
	uint8_t  audio_stage;       /* how far audio_init() progressed (see audio.c) */
	uint8_t  live_cs_osc_sw;    /* CS42L42 0x1109 osc switch status (0x02 = SCLK→MCLK ok) */
	uint8_t  live_cs_hp_ctl;    /* CS42L42 0x2001 HP_CTL now (0x01 unmuted, 0x0D muted) */
	uint8_t  _pad[7];
} codec_diag_t;

/* Re-read live codec state into the diag struct (called before reporting). */
void codec_refresh_diag(void);

/* Record whether the I2S stream is running, into the diag struct. */
void codec_note_audio_running(bool running);

/* Record audio_init progress: i2s_configure return code + stage reached. */
void codec_note_audio(int cfg_ret, uint8_t stage);

void codec_get_diag(codec_diag_t *out);
```

## src/disk.c
```c
#include "disk.h"
#include "emmc.h"
#include <string.h>

_Static_assert(sizeof(disk_song_entry_t) == 32, "disk_song_entry_t must be 32 bytes");
_Static_assert(sizeof(disk_header_t) == 512, "disk_header_t must be 512 bytes");

static uint8_t s_cat_buf[512];

bool disk_read_header(disk_header_t *hdr)
{
    if (!hdr) return false;
    if (!emmc_read_block(DISK_HEADER_BLOCK, (uint8_t *)hdr)) return false;
    return hdr->magic == DISK_MAGIC && hdr->version == DISK_VERSION;
}

bool disk_write_header(const disk_header_t *hdr)
{
    if (!hdr) return false;
    return emmc_write_block(DISK_HEADER_BLOCK, (const uint8_t *)hdr);
}

bool disk_format(void)
{
    static disk_header_t hdr;
    memset(&hdr, 0, sizeof(hdr));
    hdr.magic            = DISK_MAGIC;
    hdr.version          = DISK_VERSION;
    hdr.song_count       = 0;
    hdr.next_free_block  = DISK_DATA_START_BLOCK;
    if (!disk_write_header(&hdr)) return false;

    memset(s_cat_buf, 0, sizeof(s_cat_buf));
    for (uint8_t b = 0; b < DISK_CATALOG_BLOCKS; b++) {
        if (!emmc_write_block(DISK_CATALOG_START + b, s_cat_buf)) return false;
    }
    return true;
}

static uint32_t cat_block(uint16_t idx)
{
    return DISK_CATALOG_START + idx / DISK_SONGS_PER_BLOCK;
}

static uint32_t cat_offset(uint16_t idx)
{
    return (idx % DISK_SONGS_PER_BLOCK) * (uint32_t)sizeof(disk_song_entry_t);
}

bool disk_read_song(uint16_t idx, disk_song_entry_t *entry)
{
    if (!entry || idx >= DISK_MAX_SONGS) return false;
    if (!emmc_read_block(cat_block(idx), s_cat_buf)) return false;
    memcpy(entry, s_cat_buf + cat_offset(idx), sizeof(disk_song_entry_t));
    return true;
}

bool disk_write_song(uint16_t idx, const disk_song_entry_t *entry)
{
    if (!entry || idx >= DISK_MAX_SONGS) return false;
    if (!emmc_read_block(cat_block(idx), s_cat_buf)) return false;
    memcpy(s_cat_buf + cat_offset(idx), entry, sizeof(disk_song_entry_t));
    return emmc_write_block(cat_block(idx), s_cat_buf);
}

uint16_t disk_add_song(disk_header_t *hdr, const disk_song_entry_t *entry)
{
    if (!hdr || !entry || entry->name[0] == DISK_ENTRY_FREE_MARKER) return 0xFFFFu;

    /* Scan allocated range for a deleted hole to reuse */
    for (uint16_t i = 0; i < hdr->song_count; i++) {
        disk_song_entry_t e;
        if (!disk_read_song(i, &e)) return 0xFFFFu;
        if (e.name[0] == DISK_ENTRY_FREE_MARKER) {
            if (!disk_write_song(i, entry)) return 0xFFFFu;
            return i;
        }
    }

    /* Append */
    if (hdr->song_count >= DISK_MAX_SONGS) return 0xFFFFu;
    uint16_t idx = hdr->song_count;
    if (!disk_write_song(idx, entry)) return 0xFFFFu;
    hdr->song_count++;
    return idx;
}

bool disk_remove_song(uint16_t idx)
{
    disk_song_entry_t empty;
    memset(&empty, 0, sizeof(empty));
    return disk_write_song(idx, &empty);
}
```

## src/leds.c
```c
#include "leds.h"
#include "pwm.h"
#include "util.h"

const struct led pb_leds[NUM_PB_LEDS] = {
	{ NRF_P1, 13 }, { NRF_P0, 0 }, { NRF_P1, 12 }, { NRF_P0, 1 },
};

const struct led track_leds[NUM_TRK_LEDS] = {
	{ NRF_P0, 29 }, { NRF_P0, 26 }, { NRF_P1, 15 }, { NRF_P1, 14 },
};

void leds_init(void)
{
	for (int i = 0; i < NUM_PB_LEDS; i++)
		pb_leds[i].port->PIN_CNF[pb_leds[i].pin] = GPIO_OUT_CNF;
	for (int i = 0; i < NUM_TRK_LEDS; i++)
		track_leds[i].port->PIN_CNF[track_leds[i].pin] = GPIO_OUT_CNF;
	all_pb_off();
	all_trk_off();
}

/* pb_leds are driven by PWM1 (so they can be dimmed). on/off = full/zero duty. */
void all_pb_off(void)
{
	for (int i = 0; i < NUM_PB_LEDS; i++)
		pwm1_set_duty(i, 0);
}

void set_pb_on(int i)
{
	pwm1_set_duty(i, PWM_TOP);
}

void all_trk_off(void)
{
	for (int i = 0; i < NUM_TRK_LEDS; i++)
		track_leds[i].port->OUTCLR = (1u << track_leds[i].pin);
}

void set_trk_on(int i)
{
	track_leds[i].port->OUTSET = (1u << track_leds[i].pin);
}
```

## src/leds.h
```c
#pragma once

#include <soc.h>
#include <stdint.h>

struct led { NRF_GPIO_Type *port; uint32_t pin; };

#define NUM_PB_LEDS  4
#define NUM_TRK_LEDS 4

extern const struct led pb_leds[NUM_PB_LEDS];
extern const struct led track_leds[NUM_TRK_LEDS];

void leds_init(void);

void all_pb_off(void);
void set_pb_on(int i);

void all_trk_off(void);
void set_trk_on(int i);
```
