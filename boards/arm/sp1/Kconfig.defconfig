## boards/arm/sp1/Kconfig.defconfig
```kconfig
if BOARD_SP1

config HW_STACK_PROTECTION
	default y if ARCH_HAS_STACK_PROTECTION

config ROM_START_OFFSET
	default 0x20000

endif
```

## boards/arm/sp1/Kconfig.sp1
```kconfig
# SPDX-License-Identifier: Apache-2.0

config BOARD_SP1
	bool "SP-1 Stem Player"
	select SOC_NRF52840_QIAA
```

## boards/arm/sp1/board.yml
```yaml
board:
  name: sp1
  full_name: SP-1 Stem Player
  vendor: teeneng
  socs:
  - name: nrf52840
```

## boards/arm/sp1/sp1_defconfig
```kconfig
CONFIG_ARM_MPU=y

CONFIG_GPIO=y

CONFIG_PM=y

CONFIG_FLASH_SIZE=1024
CONFIG_FLASH_BASE_ADDRESS=0x0
CONFIG_FLASH_LOAD_OFFSET=0x20000

CONFIG_CONSOLE=n
CONFIG_SERIAL=n
CONFIG_UART_CONSOLE=n

CONFIG_I2C=y
CONFIG_I2S=y
```
